#include "headfile.h"


FSP_CPP_HEADER
void R_BSP_WarmStart(bsp_warm_start_event_t event);
FSP_CPP_FOOTER

/*******************************************************************************************************************//**
 * main() is generated by the RA Configuration editor and is used to generate threads if an RTOS is used.  This function
 * is called by main() when no RTOS is used.
 **********************************************************************************************************************/
void hal_entry(void)
{
    fsp_err_t err;
    //char msg[100];
    
    // 1. 打开调试串口
    err = g_uart7.p_api->open(g_uart7.p_ctrl, g_uart7.p_cfg);
    if(FSP_SUCCESS != err)
    {
        while(1);  // 初始化失败，停在这里
    }
    
    // 2. 打开1ms定时器
    err = g_timer_1ms.p_api->open(g_timer_1ms.p_ctrl, g_timer_1ms.p_cfg);
    err = g_timer_1ms.p_api->start(g_timer_1ms.p_ctrl);
    
    R_BSP_SoftwareDelay(1500, BSP_DELAY_UNITS_MILLISECONDS);
    
    
    // 3. 初始化串口屏
    UART_HIM_Init();
    
    
    // 4. 初始化AS608
    AS608_Init();
    
    // 5. 初始化PN532
    PN532_INIT();
    
    // 6. 初始化板载LED

    //初始化k230通信模块
    uart8_init();
    
    
    //初始化esp32通信模块
    uart2_init();
    //初始化语音通信
    uart9_init();
    //初始化舵机
    if (!motor_init())
    {
        // 初始化失败处理
        while(1); // 或LED闪烁指示错误
    }

    
    
    printf("INIT sucessful!!");
    while (1)
    {
        //指纹检索
        finger_search();
        //屏机互通
        HIM_connection();
        //NFC互通
        PN532_connect();
        key_scan();  // 每10ms扫描一次
        //k230互通
        process_uart8_data();
        //esp32互通
         process_uart2_data();
        //时间更新
        update_clock_display();
        //舵机更新
        motor_task();

    }
    
    /* TODO: add your own code here */

#if BSP_TZ_SECURE_BUILD
    /* Enter non-secure code */
    R_BSP_NonSecureEnter();
#endif
}

/*******************************************************************************************************************//**
 * This function is called at various points during the startup process.  This implementation uses the event that is
 * called right before main() to set up the pins.
 *
 * @param[in]  event    Where at in the start up process the code is currently at
 **********************************************************************************************************************/
void R_BSP_WarmStart (bsp_warm_start_event_t event)
{
    if (BSP_WARM_START_RESET == event)
    {
#if BSP_FEATURE_FLASH_LP_VERSION != 0

        /* Enable reading from data flash. */
        R_FACI_LP->DFLCTL = 1U;

        /* Would normally have to wait tDSTOP(6us) for data flash recovery. Placing the enable here, before clock and
         * C runtime initialization, should negate the need for a delay since the initialization will typically take more than 6us. */
#endif
    }

    if (BSP_WARM_START_POST_C == event)
    {
        /* C runtime environment and system clocks are setup. */

        /* Configure pins. */
        R_IOPORT_Open(&IOPORT_CFG_CTRL, &IOPORT_CFG_NAME);

#if BSP_CFG_SDRAM_ENABLED

        /* Setup SDRAM and initialize it. Must configure pins first. */
        R_BSP_SdramInit(true);
#endif
    }
}

#if BSP_TZ_SECURE_BUILD

FSP_CPP_HEADER
BSP_CMSE_NONSECURE_ENTRY void template_nonsecure_callable ();

/* Trustzone Secure Projects require at least one nonsecure callable function in order to build (Remove this if it is not required to build). */
BSP_CMSE_NONSECURE_ENTRY void template_nonsecure_callable ()
{

}
FSP_CPP_FOOTER

#endif
